// Auto-generated by scripts/gen_ctap_get_info.py. DO NOT EDIT.
// Static CTAP GetInfo CBOR segments; dynamic fields are inserted at runtime.

// COSE_ALG_EDDSA = -8
// COSE_ALG_ES256 = -7
// CREDENTIAL_ID_SIZE = 70
// CTAP_GET_INFO_MAX_MSG_SIZE = 1300
// FIRMWARE_VERSION = 201
// GI_RESP_AAGUID = 3
// GI_RESP_ALGORITHMS = 10
// GI_RESP_EXTENSIONS = 2
// GI_RESP_FIRMWARE_VERSION = 14
// GI_RESP_MAX_CREDENTIAL_COUNT_IN_LIST = 7
// GI_RESP_MAX_CREDENTIAL_ID_LENGTH = 8
// GI_RESP_MAX_CRED_BLOB_LENGTH = 15
// GI_RESP_MAX_MSG_SIZE = 5
// GI_RESP_MAX_SERIALIZED_LARGE_BLOB_ARRAY = 11
// GI_RESP_OPTIONS = 4
// GI_RESP_PIN_UV_AUTH_PROTOCOLS = 6
// GI_RESP_TRANSPORTS = 9
// GI_RESP_VERSIONS = 1
// LARGE_BLOB_SIZE_LIMIT = 4096
// MAX_CREDENTIAL_COUNT_IN_LIST = 8
// MAX_CRED_BLOB_LENGTH = 32

static const uint8_t cbor_gi_prefix_before_versions[2] = {
  0xad, 0x01,
};

static const uint8_t cbor_gi_versions[26] = {
  0x83, 0x66, 0x55, 0x32, 0x46, 0x5f, 0x56, 0x32, 0x68, 0x46, 0x49, 0x44, 0x4f, 0x5f, 0x32, 0x5f,
  0x30, 0x68, 0x46, 0x49, 0x44, 0x4f, 0x5f, 0x32, 0x5f, 0x31,
};

static const uint8_t cbor_gi_after_versions_before_client_pin[96] = {
  0x02, 0x84, 0x68, 0x63, 0x72, 0x65, 0x64, 0x42, 0x6c, 0x6f, 0x62, 0x6b, 0x63, 0x72, 0x65, 0x64,
  0x50, 0x72, 0x6f, 0x74, 0x65, 0x63, 0x74, 0x6b, 0x68, 0x6d, 0x61, 0x63, 0x2d, 0x73, 0x65, 0x63,
  0x72, 0x65, 0x74, 0x6c, 0x6c, 0x61, 0x72, 0x67, 0x65, 0x42, 0x6c, 0x6f, 0x62, 0x4b, 0x65, 0x79,
  0x03, 0x50, 0x24, 0x4e, 0xb2, 0x9e, 0xe0, 0x90, 0x4e, 0x49, 0x81, 0xfe, 0x1f, 0x20, 0xf8, 0xd3,
  0xb8, 0xf4, 0x04, 0xa7, 0x62, 0x72, 0x6b, 0xf5, 0x62, 0x75, 0x70, 0xf5, 0x68, 0x63, 0x72, 0x65,
  0x64, 0x4d, 0x67, 0x6d, 0x74, 0xf5, 0x69, 0x63, 0x6c, 0x69, 0x65, 0x6e, 0x74, 0x50, 0x69, 0x6e,
};

static const uint8_t cbor_gi_after_client_pin[125] = {
  0x6a, 0x6c, 0x61, 0x72, 0x67, 0x65, 0x42, 0x6c, 0x6f, 0x62, 0x73, 0xf5, 0x6e, 0x70, 0x69, 0x6e,
  0x55, 0x76, 0x41, 0x75, 0x74, 0x68, 0x54, 0x6f, 0x6b, 0x65, 0x6e, 0xf5, 0x70, 0x6d, 0x61, 0x6b,
  0x65, 0x43, 0x72, 0x65, 0x64, 0x55, 0x76, 0x4e, 0x6f, 0x74, 0x52, 0x71, 0x64, 0xf5, 0x05, 0x19,
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  0x6b, 0x65, 0x79, 0x0b, 0x19, 0x10, 0x00, 0x0e, 0x18, 0xc9, 0x0f, 0x18, 0x20,
};

